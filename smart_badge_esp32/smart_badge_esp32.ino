#include <WiFi.h>
#include <AsyncUDP.h> //引用以使用异步UDP
#include <ESPmDNS.h>// 使用mDNS服务
#include <JPEGDecoder.h>
#include "FS.h"
#include "SPIFFS.h"
#include "base64.hpp"

/*--------------------- 一些宏定义 -------------------------*/
#define minimum(a,b)     (((a) < (b)) ? (a) : (b))

#define USE_HORIZONTAL 2  //ÉèÖÃÏÔÊ¾·½Ïò 0,1,2,3´ú±íËÄ¸ö·½Ïò

#define LCD_W 240
#define LCD_H 240

#define  u8 unsigned char
#define u16 unsigned int
#define u32 unsigned long

//画笔颜色
#define WHITE            0xFFFF
#define BLACK            0x0000   
#define BLUE             0x001F  
#define BRED             0XF81F
#define GRED             0XFFE0
#define GBLUE            0X07FF
#define RED              0xF800
#define MAGENTA          0xF81F
#define GREEN            0x07E0
#define CYAN             0x7FFF
#define YELLOW           0xFFE0
#define BROWN            0XBC40 //×ØÉ«
#define BRRED            0XFC07 //×ØºìÉ«
#define GRAY             0X8430 //»ÒÉ«
//GUI颜色

#define DARKBLUE         0X01CF //ÉîÀ¶É«
#define LIGHTBLUE        0X7D7C //Ç³À¶É«  
#define GRAYBLUE         0X5458 //»ÒÀ¶É«
//ÒÔÉÏÈýÉ«ÎªPANELµÄÑÕÉ« 
 
#define LIGHTGREEN       0X841F //Ç³ÂÌÉ«
#define LGRAY            0XC618 //Ç³»ÒÉ«(PANNEL),´°Ìå±³¾°É«

#define LGRAYBLUE        0XA651 //Ç³»ÒÀ¶É«(ÖÐ¼ä²ãÑÕÉ«)
#define LBBLUE           0X2B12 //Ç³×ØÀ¶É«(Ñ¡ÔñÌõÄ¿µÄ·´É«)

//-----------------OLED端口定义---------------- 
#define OLED_SCLK_Clr() digitalWrite(33, LOW)//SCLK
#define OLED_SCLK_Set() digitalWrite(33, HIGH)

#define OLED_SDIN_Clr() digitalWrite(14, LOW)//DIN
#define OLED_SDIN_Set() digitalWrite(14, HIGH)

#define OLED_RES_Clr() digitalWrite(26, LOW)//RES
#define OLED_RES_Set() digitalWrite(26, HIGH)

#define OLED_DC_Clr() digitalWrite(27, LOW)//DC
#define OLED_DC_Set() digitalWrite(27, HIGH)
          
#define OLED_BLK_Clr()  digitalWrite(13, LOW)//BLK
#define OLED_BLK_Set()  digitalWrite(13, HIGH)
         
#define OLED_CS_Clr()  digitalWrite(25, LOW)//CS
#define OLED_CS_Set()  digitalWrite(25, HIGH)

#define OLED_CMD  0 //
#define OLED_DATA 1 //
//----------------------------------------------------//

void LCD_Writ_Bus(u8 dat) 
{  
  u8 i;       
  for(i=0;i<8;i++)
  {       
    OLED_SCLK_Clr();
    if(dat&0x80)
       OLED_SDIN_Set();
    else 
       OLED_SDIN_Clr();
    OLED_SCLK_Set();
    dat<<=1;   
  }     
}

void LCD_WR_DATA8(u8 dat)
{
  OLED_DC_Set();//Ð´Êý¾Ý
  LCD_Writ_Bus(dat);
}

void LCD_WR_DATA(u16 dat)
{
  OLED_DC_Set();//Ð´Êý¾Ý
  LCD_Writ_Bus(dat>>8);
  LCD_Writ_Bus(dat);
}

void LCD_WR_REG(u8 dat)
{
  OLED_DC_Clr();//Ð´ÃüÁî
  LCD_Writ_Bus(dat);
}

void LCD_Address_Set(u16 x1,u16 y1,u16 x2,u16 y2)
{
  LCD_WR_REG(0x2a);//ÁÐµØÖ·ÉèÖÃ
  LCD_WR_DATA(x1);
  LCD_WR_DATA(x2);
  LCD_WR_REG(0x2b);//ÐÐµØÖ·ÉèÖÃ
  LCD_WR_DATA(y1);
  LCD_WR_DATA(y2);
  LCD_WR_REG(0x2c);//´¢´æÆ÷Ð´
}

void Lcd_Init(void)
{
  pinMode(33, OUTPUT); 
  pinMode(14, OUTPUT); 
  pinMode(27, OUTPUT); 
  pinMode(26, OUTPUT); 
  pinMode(25, OUTPUT); 
  pinMode(13, OUTPUT);
  digitalWrite(33, HIGH);
  digitalWrite(14, HIGH);
  digitalWrite(27, HIGH);
  digitalWrite(26, HIGH);
  digitalWrite(25, HIGH);
  digitalWrite(13, HIGH);
  delay(100);
  
  OLED_CS_Clr();
    
  OLED_RES_Set(); 
  delay(20);
  OLED_RES_Clr();
  delay(20);
  OLED_RES_Set();
  
  delay(120);
  OLED_BLK_Set();
  
  //************* Start Initial Sequence **********// 
  //************* Start Initial Sequence **********// 
  LCD_WR_REG(0xFE);
  LCD_WR_REG(0xEF); 
  LCD_WR_REG(0xEB);
  LCD_WR_DATA8(0x14); 
  
  LCD_WR_REG(0x84);
  LCD_WR_DATA8(0x40); 
  
  LCD_WR_REG(0x85);
  LCD_WR_DATA8(0xFF); 
  
  LCD_WR_REG(0x86);
  LCD_WR_DATA8(0xFF); 
  
  LCD_WR_REG(0x87);
  LCD_WR_DATA8(0xFF);
  
  LCD_WR_REG(0x88);
  LCD_WR_DATA8(0x0A);
  
  LCD_WR_REG(0x89);
  LCD_WR_DATA8(0x21); 
  
  LCD_WR_REG(0x8A);
  LCD_WR_DATA8(0x00); 
  
  LCD_WR_REG(0x8B);
  LCD_WR_DATA8(0x80); 
  
  LCD_WR_REG(0x8C);
  LCD_WR_DATA8(0x01); 
  
  LCD_WR_REG(0x8D);
  LCD_WR_DATA8(0x01); 
  
  LCD_WR_REG(0x8E);
  LCD_WR_DATA8(0xFF); 
  
  LCD_WR_REG(0x8F);
  LCD_WR_DATA8(0xFF); 

  LCD_WR_REG(0xB6);
  LCD_WR_DATA8(0x00); 
  LCD_WR_DATA8(0x20); 
  LCD_WR_REG(0x36);
  LCD_WR_DATA8(0x08);
  //if(USE_HORIZONTAL==0)LCD_WR_DATA8(0x18);
  //else if(USE_HORIZONTAL==1)LCD_WR_DATA8(0x28);
  //else if(USE_HORIZONTAL==2)LCD_WR_DATA8(0x48);
  //else LCD_WR_DATA8(0x88);

  LCD_WR_REG(0x3A);
  LCD_WR_DATA8(0x05); 
  
  LCD_WR_REG(0x90);
  LCD_WR_DATA8(0x08);
  LCD_WR_DATA8(0x08);
  LCD_WR_DATA8(0x08);
  LCD_WR_DATA8(0x08); 

  LCD_WR_REG(0xBD);
  LCD_WR_DATA8(0x06);
  
  LCD_WR_REG(0xBC);
  LCD_WR_DATA8(0x00);

  LCD_WR_REG(0xFF);     
  LCD_WR_DATA8(0x60);
  LCD_WR_DATA8(0x01);
  LCD_WR_DATA8(0x04);


  LCD_WR_REG(0xC3);     
  LCD_WR_DATA8(0x13);
  LCD_WR_REG(0xC4);     
  LCD_WR_DATA8(0x13);
  
  LCD_WR_REG(0xC9);
  LCD_WR_DATA8(0x22);
  
  LCD_WR_REG(0xBE);
  LCD_WR_DATA8(0x11);

  LCD_WR_REG(0xE1);
  LCD_WR_DATA8(0x10);
  LCD_WR_DATA8(0x0E); 

  LCD_WR_REG(0xDF);
  LCD_WR_DATA8(0x21);
  LCD_WR_DATA8(0x0C);
  LCD_WR_DATA8(0x02);

  LCD_WR_REG(0xF0);   
  LCD_WR_DATA8(0x45);
  LCD_WR_DATA8(0x09);
  LCD_WR_DATA8(0x08);
  LCD_WR_DATA8(0x08);
  LCD_WR_DATA8(0x26);
  LCD_WR_DATA8(0x2A);

  LCD_WR_REG(0xF1);    
  LCD_WR_DATA8(0x43);
  LCD_WR_DATA8(0x70);
  LCD_WR_DATA8(0x72);
  LCD_WR_DATA8(0x36);
  LCD_WR_DATA8(0x37);  
  LCD_WR_DATA8(0x6F);


  LCD_WR_REG(0xF2);   
  LCD_WR_DATA8(0x45);
  LCD_WR_DATA8(0x09);
  LCD_WR_DATA8(0x08);
  LCD_WR_DATA8(0x08);
  LCD_WR_DATA8(0x26);
  LCD_WR_DATA8(0x2A);

  LCD_WR_REG(0xF3);   
  LCD_WR_DATA8(0x43);
  LCD_WR_DATA8(0x70);
  LCD_WR_DATA8(0x72);
  LCD_WR_DATA8(0x36);
  LCD_WR_DATA8(0x37); 
  LCD_WR_DATA8(0x6F);

  LCD_WR_REG(0xED); 
  LCD_WR_DATA8(0x1B); 
  LCD_WR_DATA8(0x0B); 

  LCD_WR_REG(0xAE);     
  LCD_WR_DATA8(0x77);
  
  LCD_WR_REG(0xCD);     
  LCD_WR_DATA8(0x63);   

  LCD_WR_REG(0x70);     
  LCD_WR_DATA8(0x07);
  LCD_WR_DATA8(0x07);
  LCD_WR_DATA8(0x04);
  LCD_WR_DATA8(0x0E); 
  LCD_WR_DATA8(0x0F); 
  LCD_WR_DATA8(0x09);
  LCD_WR_DATA8(0x07);
  LCD_WR_DATA8(0x08);
  LCD_WR_DATA8(0x03);

  LCD_WR_REG(0xE8);     
  LCD_WR_DATA8(0x34);

  LCD_WR_REG(0x62);     
  LCD_WR_DATA8(0x18);
  LCD_WR_DATA8(0x0D);
  LCD_WR_DATA8(0x71);
  LCD_WR_DATA8(0xED);
  LCD_WR_DATA8(0x70); 
  LCD_WR_DATA8(0x70);
  LCD_WR_DATA8(0x18);
  LCD_WR_DATA8(0x0F);
  LCD_WR_DATA8(0x71);
  LCD_WR_DATA8(0xEF);
  LCD_WR_DATA8(0x70); 
  LCD_WR_DATA8(0x70);

  LCD_WR_REG(0x63);     
  LCD_WR_DATA8(0x18);
  LCD_WR_DATA8(0x11);
  LCD_WR_DATA8(0x71);
  LCD_WR_DATA8(0xF1);
  LCD_WR_DATA8(0x70); 
  LCD_WR_DATA8(0x70);
  LCD_WR_DATA8(0x18);
  LCD_WR_DATA8(0x13);
  LCD_WR_DATA8(0x71);
  LCD_WR_DATA8(0xF3);
  LCD_WR_DATA8(0x70); 
  LCD_WR_DATA8(0x70);

  LCD_WR_REG(0x64);     
  LCD_WR_DATA8(0x28);
  LCD_WR_DATA8(0x29);
  LCD_WR_DATA8(0xF1);
  LCD_WR_DATA8(0x01);
  LCD_WR_DATA8(0xF1);
  LCD_WR_DATA8(0x00);
  LCD_WR_DATA8(0x07);

  LCD_WR_REG(0x66);     
  LCD_WR_DATA8(0x3C);
  LCD_WR_DATA8(0x00);
  LCD_WR_DATA8(0xCD);
  LCD_WR_DATA8(0x67);
  LCD_WR_DATA8(0x45);
  LCD_WR_DATA8(0x45);
  LCD_WR_DATA8(0x10);
  LCD_WR_DATA8(0x00);
  LCD_WR_DATA8(0x00);
  LCD_WR_DATA8(0x00);

  LCD_WR_REG(0x67);     
  LCD_WR_DATA8(0x00);
  LCD_WR_DATA8(0x3C);
  LCD_WR_DATA8(0x00);
  LCD_WR_DATA8(0x00);
  LCD_WR_DATA8(0x00);
  LCD_WR_DATA8(0x01);
  LCD_WR_DATA8(0x54);
  LCD_WR_DATA8(0x10);
  LCD_WR_DATA8(0x32);
  LCD_WR_DATA8(0x98);

  LCD_WR_REG(0x74);     
  LCD_WR_DATA8(0x10); 
  LCD_WR_DATA8(0x85); 
  LCD_WR_DATA8(0x80);
  LCD_WR_DATA8(0x00); 
  LCD_WR_DATA8(0x00); 
  LCD_WR_DATA8(0x4E);
  LCD_WR_DATA8(0x00);         
  
  LCD_WR_REG(0x98);     
  LCD_WR_DATA8(0x3e);
  LCD_WR_DATA8(0x07);

  LCD_WR_REG(0x35); 
  LCD_WR_DATA8(0x00); 

  LCD_WR_REG(0x21);

  LCD_WR_REG(0x11);
  delay(120);
  LCD_WR_REG(0x29);
  delay(20);
} 

void LCD_Clear(u16 Color)
{
  u16 i,j;    
  LCD_Address_Set(0,0,LCD_W-1,LCD_H-1);
    for(i=0;i<LCD_W;i++)
   {
    for (j=0;j<LCD_H;j++)
      {
          LCD_WR_DATA(Color);        
      }

    }
}

const u8 asc2_1608[1520]={
0x00,0x00,0x00,0x00,0x00,0x00,0x00,0x00,0x00,0x00,0x00,0x00,0x00,0x00,0x00,0x00,
0x00,0x00,0x00,0x08,0x08,0x08,0x08,0x08,0x08,0x08,0x00,0x00,0x18,0x18,0x00,0x00,
0x00,0x48,0x6C,0x24,0x12,0x00,0x00,0x00,0x00,0x00,0x00,0x00,0x00,0x00,0x00,0x00,
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0x0C,0x32,0xC2,0x00,0x00,0x00,0x00,0x00,0x00,0x00,0x00,0x00,0x00,0x00,0x00,0x00,
}; 

void LCD_DrawPoint(u16 x,u16 y,u16 color)
{
  LCD_Address_Set(x,y,x,y);
  LCD_WR_DATA(color);
} 

void LCD_ShowChar(u16 x,u16 y,u8 num,u8 mode,u16 color)
{
  u8 temp;
  u8 pos,t;
  u16 x0=x;     
  if(x>LCD_W-16||y>LCD_H-16)return;     //ÉèÖÃ´°¿Ú       
  num=num-' ';//µÃµ½Æ«ÒÆºóµÄÖµ
  LCD_Address_Set(x,y,x+8-1,y+16-1);      //ÉèÖÃ¹â±êÎ»ÖÃ 
  if(!mode){
    for(pos=0;pos<16;pos++){ 
      temp=asc2_1608[(u16)num*16+pos];     //µ÷ÓÃ1608×ÖÌå
      for(t=0;t<8;t++){                 
            if(temp&0x01)LCD_WR_DATA(color);
            else LCD_WR_DATA(BLACK);
            temp>>=1; 
            x++;
        }
      x=x0;
      y++;
    } 
  }else{
    for(pos=0;pos<16;pos++){
        temp=asc2_1608[(u16)num*16+pos];     //µ÷ÓÃ1608×ÖÌå
        for(t=0;t<8;t++){                 
            if(temp&0x01)LCD_DrawPoint(x+t,y+pos,color);//»­Ò»¸öµã     
            temp>>=1; 
        }
    }
  }             
}

u32 mypow(u8 m,u8 n)
{
  u32 result=1;  
  while(n--)result*=m;    
  return result;
}

void LCD_ShowNum(u16 x,u16 y,u16 num,u8 len,u16 color)
{           
  u8 t,temp;
  u8 enshow=0;
  for(t=0;t<len;t++){
    temp=(num/mypow(10,len-t-1))%10;
    if(enshow==0&&t<(len-1)){
      if(temp==0){
        LCD_ShowChar(x+8*t,y,' ',0,color);
        continue;
      }else enshow=1; 
    }
    LCD_ShowChar(x+8*t,y,temp+48,0,color); 
  }
} 

void LCD_ShowString(u16 x,u16 y,const char *p,u16 color)
{         
    while(*p!='\0'){       
        if(x>LCD_W-16){x=0;y+=16;}
        if(y>LCD_H-16){y=x=0;LCD_Clear(RED);}
        LCD_ShowChar(x,y,*p,0,color);
        x+=8;
        p++;
    }  
}

void LCD_ShowPicture(u16 x1,u16 y1,const u8 *image1,u16 x2,u16 y2)
{
  unsigned int i;
  LCD_Address_Set(x1,y1,x2,y2);
  for(i=0;i<57600;i++)
  {
    LCD_WR_DATA8(image1[i*2+1]);   
    LCD_WR_DATA8(image1[i*2]);
  }
}

void writeImage( fs::FS &fs, const uint8_t *buff, int fileLength )
{
  Serial.println("Writing the image to the sd card ...........");
  File file = fs.open( "/customPic1.jpg", FILE_APPEND );
  
  if( !file ){
    Serial.println( "Failed to open file for writing ..." );
    return;  
  }
    
  size_t length = file.write( buff, fileLength );
  Serial.printf( "write bytes: %d\n", length );

  file.close();  
}

void readFile( fs::FS &fs, const char * path, char *readBuff )
{
 // Serial.println( "Reading the image from the File System ............" );
  File file = fs.open( path );
  if(!file){
    Serial.println("Failed to open file for reading");
    return;
  }
 // Serial.println( "Open the image file successfully .... " );
  size_t fileSize = file.size();
 // Serial.printf( "The size of the Image file: %d \n", fileSize );

  size_t readLength = file.readBytes( readBuff, fileSize );
 // Serial.printf( "Read bytes from the file is: %d \n", readLength );

  file.close();
}

void jpegInfo() {
  Serial.println(F("==============="));
  Serial.println(F("JPEG image info"));
  Serial.println(F("==============="));
  Serial.print(F(  "Width      :")); Serial.println(JpegDec.width);
  Serial.print(F(  "Height     :")); Serial.println(JpegDec.height);
  Serial.print(F(  "Components :")); Serial.println(JpegDec.comps);
  Serial.print(F(  "MCU / row  :")); Serial.println(JpegDec.MCUSPerRow);
  Serial.print(F(  "MCU / col  :")); Serial.println(JpegDec.MCUSPerCol);
  Serial.print(F(  "Scan type  :")); Serial.println(JpegDec.scanType);
  Serial.print(F(  "MCU width  :")); Serial.println(JpegDec.MCUWidth);
  Serial.print(F(  "MCU height :")); Serial.println(JpegDec.MCUHeight);
  Serial.println(F("==============="));
}

void renderJPEG(int xpos, int ypos ) {
  Serial.println("render jpg ...");
  // retrieve infomration about the image
  uint16_t *pImg;
  uint16_t mcu_w = JpegDec.MCUWidth;
  uint16_t mcu_h = JpegDec.MCUHeight;
  uint32_t max_x = JpegDec.width;
  uint32_t max_y = JpegDec.height;

  // Jpeg images are draw as a set of image block (tiles) called Minimum Coding Units (MCUs)
  // Typically these MCUs are 8x8 pixel blocks
  // Determine the width and height of the right and bottom edge image blocks
  uint32_t min_w = minimum(mcu_w, max_x % mcu_w);
  uint32_t min_h = minimum(mcu_h, max_y % mcu_h);

  // save the current image block size
  uint32_t win_w = mcu_w;
  uint32_t win_h = mcu_h;

  // save the coordinate of the right and bottom edges to assist image cropping
  // to the screen size
  max_x += xpos;
  max_y += ypos;

  // read each MCU block until there are no more
  while ( JpegDec.read()) {
    // save a pointer to the image block
    pImg = JpegDec.pImage;

    // calculate where the image block should be drawn on the screen
    int mcu_x = JpegDec.MCUx * mcu_w + xpos;
    int mcu_y = JpegDec.MCUy * mcu_h + ypos;

    // check if the image block size needs to be changed for the right and bottom edges
    if (mcu_x + mcu_w <= max_x) win_w = mcu_w;
    else win_w = min_w;
    if (mcu_y + mcu_h <= max_y) win_h = mcu_h;
    else win_h = min_h;

    // calculate how many pixels must be drawn
    uint32_t mcu_pixels = win_w * win_h;
    //Serial.printf( "mcu_pixels = %d\r\n", mcu_pixels );

    // draw image block if it will fit on the screen
    if ( ( mcu_x + win_w) <= 240 && ( mcu_y + win_h) <= 240) {
      LCD_Address_Set( mcu_x, mcu_y, mcu_x + win_w - 1, mcu_y + win_h - 1 );
      while (mcu_pixels--){
        LCD_WR_DATA8( ( (*pImg) >> 8 ) & 0xff );
        LCD_WR_DATA8( (*pImg) & 0xff );
        pImg ++;
      }
    }
    // stop drawing blocks if the bottom of the screen has been reached
    // the abort function will close the file
    else if ( ( mcu_y + win_h) >= 240) JpegDec.abort();
  }
}

void readJpeg( fs::FS &fs, const char * path )
{
  File file = fs.open( path );
  if(!file){
    Serial.println("Failed to open file for reading");
    return;
  }
  Serial.println( "Open the image file successfully .... " );
  size_t fileSize = file.size();
  Serial.printf( "The size of the Image file: %d \n", fileSize );

  if( fileSize < 2000 ){ // 如果文件不完整，就删掉它，防止出错
    file.close();  
    if( SPIFFS.remove( "/customPic1.jpg" ) ){
      Serial.println( "删除原始图片" );
    }
  }
  else {
    //size_t readLength = file.readBytes( readBuff, fileSize );
    //Serial.printf( "Read bytes from the file is: %d \n", readLength );
    JpegDec.decodeSdFile(file);
    
    jpegInfo();

    if( JpegDec.width != 0 && JpegDec.height != 0 )
      renderJPEG( 0, 0 );
    
    file.close(); 
  } 
}

/* 全局变量 */
AsyncUDP udp;                     //创建UDP对象

const char *ssid = "1234567";
const char *password = "xd123456";

uint8_t receive_count = 0;
unsigned int binary_length = 0;
unsigned int binary_length_sum = 0;
unsigned char data1[2000];

bool recvFlag = false;

void onPacketCallBack(AsyncUDPPacket packet)
{
  if( packet.length() > 10 && packet.length() < 1000 ){
    receive_count ++;
    
    LCD_ShowNum( 110, 110, receive_count, 3, RED );
    memset( data1, 0, 2000 );
    
    Serial.printf("receive count: %d\r\n", receive_count);
    Serial.printf( "received: %d\r\n", packet.length() );

    binary_length = decode_base64( (unsigned char*)packet.data(), packet.length(), data1 );
    
    Serial.printf( "binary length = %d\r\n", binary_length );
    binary_length_sum += binary_length;
    Serial.printf( "binary sum = %d\r\n", binary_length_sum );
    
    writeImage( SPIFFS, data1, binary_length );

    readJpeg( SPIFFS, "/customPic1.jpg" );
    receive_count = 0;
    binary_length = 0;
    binary_length_sum = 0;
  }
  else if( packet.length() == 1000 ){
    receive_count ++;
    
    if( receive_count == 1 ){ // 收到第一帧数据之后，删除原有图片
      if( SPIFFS.remove( "/customPic1.jpg" ) ){
         Serial.println( "删除原始图片" );
      }
      
    }
    
    LCD_ShowString( 70, 60, "Start Transmit:", RED );
    LCD_ShowNum( 110, 110, receive_count, 3, RED );
    memset( data1, 0, 2000 );
    
    Serial.printf("receive count: %d\r\n", receive_count);
    Serial.printf( "received: %d\r\n", packet.length() );

    binary_length = decode_base64( (unsigned char*)packet.data(), packet.length(), data1 );
    Serial.printf( "binary length = %d\r\n", binary_length );
    if( binary_length != 750 ){ // 解码出错了
      //udp.print("restart");
      packet.print("restart");
      if( SPIFFS.remove( "/customPic1.jpg" ) ){
        Serial.println( "删除原始图片" );
      }
      receive_count = 0;
      binary_length = 0;
      binary_length_sum = 0;
    }
    
    binary_length_sum += binary_length;
    Serial.printf( "binary sum = %d\r\n", binary_length_sum );
    
    writeImage( SPIFFS, data1, binary_length );   
  }
}

String ip;
void setup() {
  Serial.begin(115200);
  
  Lcd_Init();
  LCD_Clear( BLACK );
  Serial.println( "Initialize the LCD ..." );
  delay(500);

  /* -------------- Init Key IO ------------------- */
  pinMode( 0, INPUT );

  /* -------------- Mount File System ------------- */
  if( SPIFFS.begin( true ) ){
    Serial.println( "File System Mounted ..." );
  }
  readJpeg( SPIFFS, "/customPic1.jpg" );

  /*-------------- connect to WiFi --------------*/
  Serial.printf("Connecting to %s ", ssid);
  WiFi.begin(ssid, password);
  while (WiFi.status() != WL_CONNECTED) {
      delay(500);
      Serial.print(".");
  }
  Serial.println(" CONNECTED");

  ip = WiFi.localIP().toString();
  Serial.println( "IP: " );
  Serial.println( ip );
  
  delay( 100 );

  /*------------ mDNS Init ---------------*/
  if (!MDNS.begin("Smart Badge")) {
    Serial.println("Error setting up MDNS responder!");
    while(1) {
      delay(1000);
    }
  }
  Serial.println("mDNS responder started");
  MDNS.addService("test", "udp", 2333);

  /*------------- UDP Init ---------------*/
  delay(100);
  while( !udp.listen( 2333 ) ){ //监听2333端口
    
  }
  udp.onPacket( onPacketCallBack );// 注册回调函数
  
}

uint8_t keyPressed = 0;
void loop() {
  // put your main code here, to run repeatedly:
  int buttonState = digitalRead( 0 );
  if (buttonState == LOW){
    delay( 50 );
    Serial.println( "Button is pressed ..." );
    keyPressed ++;
    LCD_Clear( BLACK );
    
    if( keyPressed == 1 ){
      LCD_ShowString( 70, 60, "device name:", RED );
      LCD_ShowString( 70, 80, "Smart Badge", RED );
      LCD_ShowString( 70, 100, "Ip Address: ", RED );
      LCD_ShowString( 70, 120, ip.c_str(), RED );
      LCD_ShowString( 70, 140, "Ip Port: ", RED );
      LCD_ShowString( 70, 160, "2333", RED );
    }
    else if( keyPressed >= 2 ){
      readJpeg( SPIFFS, "/customPic1.jpg" );
      keyPressed = 0;
    }
  }
  delay(100);
}
